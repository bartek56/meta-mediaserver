## conf/layer.conf
```bitbake
# We have a conf and classes directory, add to BBPATH
BBPATH .= ":${LAYERDIR}"

# We have recipes-* directories, add to BBFILES
BBFILES += "${LAYERDIR}/recipes*/*.bb \
            ${LAYERDIR}/recipes*/*.bbappend"

BBFILES += "${LAYERDIR}/recipes*/*/*.bb \
            ${LAYERDIR}/recipes*/*/*.bbappend"

PACKAGECONFIG:append:pn-php= " apache2"

BBFILE_COLLECTIONS += "mediaserver"
BBFILE_PATTERN_mediaserver = "^${LAYERDIR}/"
BBFILE_PRIORITY_mediaserver = "5"
LAYERVERSION_mediaserver = "3"

LAYERSERIES_COMPAT_mediaserver = "kirkstone"
```
